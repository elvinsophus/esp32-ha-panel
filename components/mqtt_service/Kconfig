## components/mqtt_service/Kconfig
```kconfig
menu "HAPanel MQTT"

    config HAPANEL_MQTT_BROKER_URI
        string "MQTT broker URI"
        default ""
        help
            Optional MQTT broker URI for early Home Assistant bring-up, for
            example mqtt://192.168.1.10:1883. Leave empty until runtime
            provisioning exists.

    config HAPANEL_MQTT_CLIENT_ID
        string "MQTT client ID"
        default "hapanel"
        help
            MQTT client identifier used when connecting to the broker.

    config HAPANEL_MQTT_USERNAME
        string "MQTT username"
        default ""
        help
            Optional MQTT username. Avoid committing local credentials into
            sdkconfig defaults.

    config HAPANEL_MQTT_PASSWORD
        string "MQTT password"
        default ""
        help
            Optional MQTT password. Avoid committing local credentials into
            sdkconfig defaults.

    config HAPANEL_MQTT_AVAILABILITY_TOPIC
        string "MQTT availability topic"
        default "hapanel/status"
        help
            Retained availability topic used for early Home Assistant bring-up.
            The panel publishes "online" when connected and configures a last
            will of "offline".

    config HAPANEL_MQTT_DEVICE_STATUS_TOPIC
        string "MQTT device status topic"
        default "hapanel/device/status"
        help
            Retained JSON topic with a minimal structured device status payload.
            This is the stable foundation for future Home Assistant discovery.

    config HAPANEL_MQTT_DEVICE_STATE_TOPIC
        string "MQTT device state topic"
        default "hapanel/device/state"
        help
            Retained JSON topic with live panel state such as service statuses,
            runtime revision, uptime, and PSRAM readiness.

    config HAPANEL_MQTT_COMMAND_TOPIC
        string "MQTT command topic"
        default "hapanel/device/command"
        help
            Non-retained command topic for safe foundation-level panel actions.
            Supported commands are {"command":"status_refresh"} and
            {"command":"ui_refresh"}.

    config HAPANEL_MQTT_COMMAND_RESULT_TOPIC
        string "MQTT command result topic"
        default "hapanel/device/command/result"
        help
            Non-retained JSON topic used to report accepted, rejected, and
            malformed command payloads.

    config HAPANEL_MQTT_COMMAND_STATE_TOPIC
        string "MQTT command state topic"
        default "hapanel/device/command/state"
        help
            Retained JSON topic with the latest command result for Home
            Assistant diagnostics.

    config HAPANEL_MQTT_HA_DISCOVERY_ENABLE
        bool "Publish Home Assistant MQTT discovery"
        default y
        help
            Publish retained MQTT discovery payloads so Home Assistant can
            create HAPanel entities automatically.

    config HAPANEL_MQTT_HA_DISCOVERY_PREFIX
        string "Home Assistant MQTT discovery prefix"
        default "homeassistant"
        depends on HAPANEL_MQTT_HA_DISCOVERY_ENABLE
        help
            MQTT discovery prefix configured in Home Assistant. The default is
            homeassistant.

endmenu
```

## components/network/Kconfig
```kconfig
menu "HAPanel Network"

    config HAPANEL_WIFI_SSID
        string "Wi-Fi SSID"
        default ""
        help
            Optional Wi-Fi SSID for early bring-up. Leave empty to keep Wi-Fi
            initialized but disconnected until runtime provisioning exists.

    config HAPANEL_WIFI_PASSWORD
        string "Wi-Fi password"
        default ""
        help
            Optional Wi-Fi password for early bring-up. Avoid committing local
            credentials into sdkconfig defaults.

endmenu
```

## components/ota/Kconfig
```kconfig
menu "HAPanel OTA"

    config HAPANEL_OTA_SELF_TEST_STAGE_FACTORY_ON_BOOT
        bool "Stage factory image into OTA slot on boot for self-test"
        default n
        help
            Development-only bring-up switch. When enabled, a boot from the
            factory partition copies the running app image into the next OTA
            slot through the normal OTA session API and sets that slot as the
            next boot target.

            The panel does not restart automatically. Leave this disabled for
            normal firmware builds.

    config HAPANEL_OTA_MQTT_SELF_TEST_STAGE_ENABLE
        bool "Enable MQTT-triggered OTA self-test staging"
        default n
        help
            Development-only bring-up switch. When enabled, MQTT can trigger a
            local OTA self-test that copies the currently running app image into
            the inactive OTA slot and sets that slot as the next boot target.

            This writes flash and changes the next boot partition, but it does
            not restart the panel automatically. Leave this disabled for normal
            firmware builds.

endmenu
```

## sdkconfig.defaults.local.example
```kconfig
# Copy this file to sdkconfig.defaults.local for local hardware bring-up.
# Do not commit sdkconfig.defaults.local; it may contain network credentials.

# CONFIG_HAPANEL_WIFI_SSID="YourWiFiSSID"
# CONFIG_HAPANEL_WIFI_PASSWORD="YourWiFiPassword"

# CONFIG_HAPANEL_MQTT_BROKER_URI="mqtt://192.168.1.10:1883"
# CONFIG_HAPANEL_MQTT_CLIENT_ID="hapanel"
# CONFIG_HAPANEL_MQTT_USERNAME="mqtt_user"
# CONFIG_HAPANEL_MQTT_PASSWORD="mqtt_password"
# CONFIG_HAPANEL_MQTT_AVAILABILITY_TOPIC="hapanel/status"
```
